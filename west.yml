## west.yml
```yaml
# Copyright 2024 Silicon Laboratories Inc.
# SPDX-License-Identifier: Apache-2.0

# West manifest file for Simplicity SDK for Zephyr.
#
# The west workspace configuration file, .west/config, sets the
# path to the project containing this file in the [manifest] section's
# "path" variable.
#
# You are free to create your own manifest files and put them in any
# repository you want, to create your own custom workspaces.
# For example, you could create a manifest file in your own application
# directory, which would pull this repository in as an ordinary project.
#
# You can pass your manifest repository to west init when creating a
# new workspace. See the west documentation for more information.

manifest:
  remotes:
    - name: zephyrproject-rtos
      url-base: https://github.com/zephyrproject-rtos
    - name: silabs
      url-base: https://github.com/siliconlabssoftware
    - name: db00lean
      url-base: https://github.com/db00lean

  projects:
    - name: zephyr
      remote: db00lean
      revision: 9bc58ee67181f16c06495795b318072dd73c1998
      import:
        # Simplicity SDK for Zephyr imports the Zephyr main tree at the
        # revision given above. Only the modules named below are imported.
        # If a module is overridden it is not listed here, and instead
        # added separately at the top level.
        name-allowlist:
          - cmsis-dsp
          - cmsis-nn
          - cmsis_6
          - fatfs
          - littlefs
          - lvgl
          - mbedtls
          - mldsa-native
          - openthread
          - picolibc
          - segger
          - zcbor
    - name: hal_silabs
      remote: db00lean
      revision: 0ad779243b5cbefcce6c14456a0096fc13e09e67
      path: modules/hal/silabs
    - name: mcuboot
      remote: silabs
      repo-path: zephyr-mcuboot
      revision: b8ae4003ea5eadd1b29a42d52e383e724deba023
      path: bootloader/mcuboot
    - name: tf-psa-crypto
      remote: silabs
      repo-path: zephyr-tf-psa-crypto
      revision: d71bd7c8a97b9bfbe3b504359276138754113521
      path: modules/crypto/tf-psa-crypto
    - name: zephyr-hal-silabs-extra
      remote: silabs
      revision: 04ea2a26baf2d0a768ce5c8970a754bbdd71e9b1
      path: modules/hal/silabs_extra
```
